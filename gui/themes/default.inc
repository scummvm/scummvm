 "<?xml version = '1.0'?>"
"<render_info> "
"<palette> "
"<color name='black' "
"rgb='0,0,0' "
"/> "
"<color name='lightgrey' "
"rgb='104,104,104' "
"/> "
"<color name='darkgrey' "
"rgb='64,64,64' "
"/> "
"<color name='green' "
"rgb='32,160,32' "
"/> "
"<color name='green2' "
"rgb='0,255,0' "
"/> "
"</palette> "
"<fonts> "
"<font id='text_default' "
"file='default' "
"color='green' "
"/> "
"<font id='text_hover' "
"file='default' "
"color='green2' "
"/> "
"<font id='text_disabled' "
"file='default' "
"color='lightgrey' "
"/> "
"<font id='text_inverted' "
"file='default' "
"color='black' "
"/> "
"<font id='text_button' "
"file='default' "
"color='green' "
"/> "
"<font id='text_button_hover' "
"file='default' "
"color='green2' "
"/> "
"<font id='text_normal' "
"file='default' "
"color='green' "
"/> "
"</fonts> "
"<defaults fill='foreground' fg_color='darkgrey' bg_color='black' shadow='0' bevel_color='lightgrey'/> "
"<drawdata id='text_selection' cache='false'> "
"<drawstep func='square' "
"fill='foreground' "
"fg_color='green' "
"/> "
"</drawdata> "
"<drawdata id='mainmenu_bg' cache='false'> "
"<drawstep func='fill' "
"fill='foreground' "
"fg_color='black' "
"/> "
"</drawdata> "
"<drawdata id='special_bg' cache='false'> "
"<drawstep func='bevelsq' "
"bevel='2' "
"/> "
"</drawdata> "
"<drawdata id='separator' cache='false'> "
"<drawstep func='square' "
"fill='foreground' "
"height='2' "
"ypos='center' "
"fg_color='lightgrey' "
"/> "
"</drawdata> "
"<drawdata id='scrollbar_base' cache='false'> "
"<drawstep func='bevelsq' "
"bevel='2' "
"/> "
"</drawdata> "
"<drawdata id='scrollbar_handle_hover' cache='false'> "
"<drawstep func='square' "
"fill='foreground' "
"fg_color='green2' "
"/> "
"</drawdata> "
"<drawdata id='scrollbar_handle_idle' cache='false'> "
"<drawstep func='square' "
"fill='foreground' "
"fg_color='green' "
"/> "
"</drawdata> "
"<drawdata id='scrollbar_button_idle' cache='false'> "
"<drawstep func='bevelsq' "
"bevel='2' "
"fill='none' "
"/> "
"<drawstep func='triangle' "
"fg_color='green' "
"fill='foreground' "
"width='auto' "
"height='auto' "
"xpos='center' "
"ypos='center' "
"orientation='top' "
"/> "
"</drawdata> "
"<drawdata id='scrollbar_button_hover' cache='false'> "
"<drawstep func='bevelsq' "
"bevel='2' "
"fill='none' "
"/> "
"<drawstep func='triangle' "
"fg_color='green2' "
"fill='foreground' "
"width='auto' "
"height='auto' "
"xpos='center' "
"ypos='center' "
"orientation='top' "
"/> "
"</drawdata> "
"<drawdata id='tab_active' cache='false'> "
"<text font='text_hover' "
"vertical_align='center' "
"horizontal_align='center' "
"/> "
"<drawstep func='tab' "
"bevel='2' "
"radius='0' "
"fill='none' "
"/> "
"</drawdata> "
"<drawdata id='tab_inactive' cache='false'> "
"<text font='text_default' "
"vertical_align='center' "
"horizontal_align='center' "
"/> "
"<drawstep func='tab' "
"bevel='2' "
"radius='0' "
"fill='none' "
"/> "
"</drawdata> "
"<drawdata id='tab_background' cache='false'> "
"</drawdata> "
"<drawdata id='widget_slider' cache='false'> "
"<drawstep func='bevelsq' "
"bevel='2' "
"fill='none' "
"/> "
"</drawdata> "
"<drawdata id='slider_disabled' cache='false'> "
"<drawstep func='square' "
"fill='foreground' "
"fg_color='lightgrey' "
"/> "
"</drawdata> "
"<drawdata id='slider_full' cache='false'> "
"<drawstep func='square' "
"fill='foreground' "
"fg_color='green' "
"/> "
"</drawdata> "
"<drawdata id='slider_hover' cache='false'> "
"<drawstep func='square' "
"fill='foreground' "
"fg_color='green2' "
"/> "
"</drawdata> "
"<drawdata id='widget_small' cache='false'> "
"<drawstep func='bevelsq' "
"bevel='2' "
"fill='none' "
"/> "
"</drawdata> "
"<drawdata id='popup_idle' cache='false'> "
"<drawstep func='bevelsq' "
"bevel='2' "
"fill='none' "
"/> "
"<drawstep func='triangle' "
"fg_color='green' "
"fill='foreground' "
"width='height' "
"height='auto' "
"xpos='right' "
"ypos='center' "
"orientation='bottom' "
"/> "
"<text font='text_default' "
"vertical_align='center' "
"horizontal_align='left' "
"/> "
"</drawdata> "
"<drawdata id='popup_disabled' cache='false'> "
"<drawstep func='bevelsq' "
"bevel='2' "
"fill='none' "
"/> "
"<drawstep func='triangle' "
"fg_color='lightgrey' "
"fill='foreground' "
"width='height' "
"height='auto' "
"xpos='right' "
"ypos='center' "
"orientation='bottom' "
"/> "
"<text font='text_disabled' "
"vertical_align='center' "
"horizontal_align='left' "
"/> "
"</drawdata> "
"<drawdata id='popup_hover' cache='false'> "
"<drawstep func='bevelsq' "
"bevel='2' "
"fill='none' "
"/> "
"<drawstep func='triangle' "
"fg_color='green2' "
"fill='foreground' "
"width='height' "
"height='auto' "
"xpos='right' "
"ypos='center' "
"orientation='bottom' "
"/> "
"<text font='text_hover' "
"vertical_align='center' "
"horizontal_align='left' "
"/> "
"</drawdata> "
"<drawdata id='widget_textedit' cache='false'> "
"<drawstep func='bevelsq' "
"bevel='2' "
"fill='none' "
"/> "
"</drawdata> "
"<drawdata id='plain_bg' cache='false'> "
"<drawstep func='bevelsq' "
"bevel='2' "
"/> "
"</drawdata> "
"<drawdata id='caret' cache='false'> "
"<drawstep func='square' "
"fill='foreground' "
"fg_color='lightgrey' "
"/> "
"</drawdata> "
"<drawdata id='default_bg' cache='false'> "
"<drawstep func='bevelsq' "
"bevel='2' "
"/> "
"</drawdata> "
"<drawdata id='button_idle' cache='false'> "
"<text font='text_button' "
"vertical_align='center' "
"horizontal_align='center' "
"/> "
"<drawstep func='bevelsq' "
"bevel='2' "
"fill='none' "
"/> "
"</drawdata> "
"<drawdata id='button_hover' cache='false'> "
"<text font='text_button_hover' "
"vertical_align='center' "
"horizontal_align='center' "
"/> "
"<drawstep func='bevelsq' "
"bevel='2' "
"fill='none' "
"/> "
"</drawdata> "
"<drawdata id='button_disabled' cache='false'> "
"<text font='text_disabled' "
"vertical_align='center' "
"horizontal_align='center' "
"/> "
"<drawstep func='bevelsq' "
"bevel='2' "
"fill='none' "
"/> "
"</drawdata> "
"<drawdata id='checkbox_disabled' cache='false'> "
"<text font='text_disabled' "
"vertical_align='top' "
"horizontal_align='left' "
"/> "
"<drawstep func='bevelsq' "
"bevel='2' "
"fill='none' "
"/> "
"</drawdata> "
"<drawdata id='checkbox_selected' cache='false'> "
"<text font='text_default' "
"vertical_align='top' "
"horizontal_align='left' "
"/> "
"<drawstep func='bevelsq' "
"bevel='2' "
"fill='none' "
"/> "
"<drawstep func='cross' "
"fill='foreground' "
"stroke='2' "
"fg_color='green' "
"/> "
"</drawdata> "
"<drawdata id='checkbox_default' cache='false'> "
"<text font='text_default' "
"vertical_align='top' "
"horizontal_align='left' "
"/> "
"<drawstep func='bevelsq' "
"bevel='2' "
"fill='none' "
"/> "
"</drawdata> "
"<drawdata id='widget_default' cache='false'> "
"<drawstep func='bevelsq' "
"bevel='2' "
"/> "
"</drawdata> "
"</render_info> "
"<layout_info resolution='-320xY,-256x240'> "
"<globals> "
"<def var='Line.Height' value='16' /> "
"<def var='Font.Height' value='16' /> "
"<def var='About.OuterBorder' value='80'/> "
"<def var='Layout.Spacing' value='8' /> "
"<def var='ShowLauncherLogo' value='0'/> "
"<def var='ShowGlobalMenuLogo' value='0'/> "
"<def var='ScummSaveLoad.ExtInfo.Visible' value='1'/> "
"<widget name='OptionsLabel' "
"size='110,Globals.Line.Height' "
"textalign='right' "
"/> "
"<widget name='SmallLabel' "
"size='24,Globals.Line.Height' "
"/> "
"<widget name='ShortOptionsLabel' "
"size='60,Globals.Line.Height' "
"/> "
"<widget name='Button' "
"size='108,24' "
"/> "
"<widget name='Slider' "
"size='128,18' "
"/> "
"<widget name='PopUp' "
"size='-1,19' "
"/> "
"<widget name='Checkbox' "
"size='-1,14' "
"/> "
"<widget name='ListWidget' "
"padding='5,0,8,0' "
"/> "
"<widget name='PopUpWidget' "
"padding='7,5,0,0' "
"/> "
"<widget name='EditTextWidget' "
"padding='5,5,0,0' "
"/> "
"<widget name='Console' "
"padding='7,5,5,5' "
"/> "
"<widget name='Scrollbar' "
"size='15,0' "
"/> "
"<widget name='TabWidget.Tab' "
"size='75,27' "
"padding='0,0,8,0' "
"/> "
"<widget name='TabWidget.NavButton' "
"size='15,18' "
"padding='0,3,4,0' "
"/> "
"</globals> "
"<dialog name='Launcher' overlays='screen'> "
"<layout type='vertical' center='true' padding='16,16,8,8'> "
"<widget name='Version' "
"height='Globals.Line.Height' "
"/> "
"<widget name='GameList'/> "
"<layout type='horizontal' padding='0,0,0,0' spacing='10'> "
"<widget name='LoadGameButton' "
"height='20' "
"/> "
"<widget name='AddGameButton' "
"height='20' "
"/> "
"<widget name='EditGameButton' "
"height='20' "
"/> "
"<widget name='RemoveGameButton' "
"height='20' "
"/> "
"</layout> "
"<space size='4'/> "
"<layout type='horizontal' padding='0,0,0,0' spacing='10'> "
"<widget name='QuitButton' "
"height='20' "
"/> "
"<widget name='AboutButton' "
"height='20' "
"/> "
"<widget name='OptionsButton' "
"height='20' "
"/> "
"<widget name='StartButton' "
"height='20' "
"/> "
"</layout> "
"</layout> "
"</dialog> "
"<dialog name='Browser' overlays='Dialog.Launcher.GameList' shading='dim'> "
"<layout type='vertical' padding='8,8,8,8'> "
"<widget name='Headline' "
"height='Globals.Line.Height' "
"/> "
"<widget name='Path' "
"height='Globals.Line.Height' "
"/> "
"<widget name='List'/> "
"<layout type='horizontal' padding='0,0,16,0'> "
"<widget name='Up' "
"type='Button' "
"/> "
"<space/> "
"<widget name='Cancel' "
"type='Button' "
"/> "
"<widget name='Choose' "
"type='Button' "
"/> "
"</layout> "
"</layout> "
"</dialog> "
"<dialog name='GlobalOptions' overlays='Dialog.Launcher.GameList' shading='dim'> "
"<layout type='vertical' padding='0,0,0,0'> "
"<widget name='TabWidget'/> "
"<layout type='horizontal' padding='16,16,16,16'> "
"<space/> "
"<widget name='Cancel' "
"type='Button' "
"/> "
"<widget name='Ok' "
"type='Button' "
"/> "
"</layout> "
"</layout> "
"</dialog> "
"<dialog name='GlobalOptions_Graphics' overlays='Dialog.GlobalOptions.TabWidget'> "
"<layout type='vertical' padding='16,16,16,16' spacing='8'> "
"<layout type='horizontal' padding='0,0,0,0' spacing='10' center='true'> "
"<widget name='grModePopupDesc' "
"type='OptionsLabel' "
"/> "
"<widget name='grModePopup' "
"type='PopUp' "
"/> "
"</layout> "
"<layout type='horizontal' padding='0,0,0,0' spacing='10' center='true'> "
"<widget name='grRenderPopupDesc' "
"type='OptionsLabel' "
"/> "
"<widget name='grRenderPopup' "
"type='PopUp' "
"/> "
"</layout> "
"<widget name='grAspectCheckbox' "
"type='Checkbox' "
"/> "
"<widget name='grFullscreenCheckbox' "
"type='Checkbox' "
"/> "
"</layout> "
"</dialog> "
"<dialog name='GlobalOptions_Audio' overlays='Dialog.GlobalOptions.TabWidget'> "
"<layout type='vertical' padding='16,16,16,16' spacing='8'> "
"<layout type='horizontal' padding='0,0,0,0' spacing='10' center='true'> "
"<widget name='auMidiPopupDesc' "
"type='OptionsLabel' "
"/> "
"<widget name='auMidiPopup' "
"type='PopUp' "
"/> "
"</layout> "
"<layout type='horizontal' padding='0,0,0,0' spacing='10' center='true'> "
"<widget name='auOPLPopupDesc' "
"type='OptionsLabel' "
"/> "
"<widget name='auOPLPopup' "
"type='PopUp' "
"/> "
"</layout> "
"<layout type='horizontal' padding='0,0,0,0' spacing='10' center='true'> "
"<widget name='auSampleRatePopupDesc' "
"type='OptionsLabel' "
"/> "
"<widget name='auSampleRatePopup' "
"type='PopUp' "
"/> "
"</layout> "
"<layout type='horizontal' padding='0,0,0,0' spacing='10'> "
"<widget name='subToggleDesc' "
"type='OptionsLabel' "
"/> "
"<widget name='subToggleButton' "
"width='150' "
"height='Globals.Slider.Height' "
"/> "
"</layout> "
"<layout type='horizontal' padding='0,0,0,0' spacing='10'> "
"<widget name='subSubtitleSpeedDesc' "
"type='OptionsLabel' "
"/> "
"<widget name='subSubtitleSpeedSlider' "
"type='Slider' "
"/> "
"<widget name='subSubtitleSpeedLabel' "
"type='SmallLabel' "
"/> "
"</layout> "
"</layout> "
"</dialog> "
"<dialog name='GlobalOptions_Volume' overlays='Dialog.GlobalOptions.TabWidget'> "
"<layout type='horizontal' padding='16,16,16,16' spacing='8'> "
"<layout type='vertical' padding='0,0,0,0' spacing='8'> "
"<layout type='horizontal' padding='0,0,0,0'> "
"<widget name='vcMusicText' "
"type='OptionsLabel' "
"/> "
"<widget name='vcMusicSlider' "
"type='Slider' "
"/> "
"<widget name='vcMusicLabel' "
"type='SmallLabel' "
"/> "
"</layout> "
"<layout type='horizontal' padding='0,0,0,0'> "
"<widget name='vcSfxText' "
"type='OptionsLabel' "
"/> "
"<widget name='vcSfxSlider' "
"type='Slider' "
"/> "
"<widget name='vcSfxLabel' "
"type='SmallLabel' "
"/> "
"</layout> "
"<layout type='horizontal' padding='0,0,0,0'> "
"<widget name='vcSpeechText' "
"type='OptionsLabel' "
"/> "
"<widget name='vcSpeechSlider' "
"type='Slider' "
"/> "
"<widget name='vcSpeechLabel' "
"type='SmallLabel' "
"/> "
"</layout> "
"</layout> "
"<layout type='vertical' padding='24,0,24,0' center='true'> "
"<widget name='vcMuteCheckbox' "
"type='Checkbox' "
"/> "
"</layout> "
"</layout> "
"</dialog> "
"<dialog name='GlobalOptions_MIDI' overlays='Dialog.GlobalOptions.TabWidget'> "
"<layout type='vertical' padding='16,16,16,16' spacing='8'> "
"<layout type='horizontal' padding='0,0,0,0' spacing='10' center='true'> "
"<widget name='mcFontButton' "
"type='Button' "
"/> "
"<widget name='mcFontPath' "
"height='Globals.Line.Height' "
"/> "
"<widget name='mcFontClearButton' "
"height='Globals.Line.Height' "
"width='Globals.Line.Height' "
"/> "
"</layout> "
"<widget name='mcMixedCheckbox' "
"type='Checkbox' "
"/> "
"<widget name='mcMt32Checkbox' "
"type='Checkbox' "
"/> "
"<widget name='mcGSCheckbox' "
"type='Checkbox' "
"/> "
"<layout type='horizontal' padding='0,0,0,0'> "
"<widget name='mcMidiGainText' "
"type='OptionsLabel' "
"/> "
"<widget name='mcMidiGainSlider' "
"type='Slider' "
"/> "
"<widget name='mcMidiGainLabel' "
"width='32' "
"height='Globals.Line.Height' "
"/> "
"</layout> "
"</layout> "
"</dialog> "
"<dialog name='GlobalOptions_Paths' overlays='Dialog.GlobalOptions.TabWidget'> "
"<layout type='vertical' padding='16,16,16,16' spacing='8'> "
"<layout type='horizontal' padding='0,0,0,0' spacing='10' center='true'> "
"<widget name='SaveButton' "
"type='Button' "
"/> "
"<widget name='SavePath' "
"height='Globals.Line.Height' "
"/> "
"</layout> "
"<layout type='horizontal' padding='0,0,0,0' spacing='10' center='true'> "
"<widget name='ThemeButton' "
"type='Button' "
"/> "
"<widget name='ThemePath' "
"height='Globals.Line.Height' "
"/> "
"</layout> "
"<layout type='horizontal' padding='0,0,0,0' spacing='10' center='true'> "
"<widget name='ExtraButton' "
"type='Button' "
"/> "
"<widget name='ExtraPath' "
"height='Globals.Line.Height' "
"/> "
"</layout> "
"<layout type='horizontal' padding='0,0,0,0' spacing='16'> "
"<widget name='PluginsButton' "
"type='Button' "
"/> "
"<widget name='PluginsPath' "
"height='Globals.Line.Height' "
"/> "
"</layout> "
"</layout> "
"</dialog> "
"<dialog name='GlobalOptions_Misc' overlays='Dialog.GlobalOptions.TabWidget'> "
"<layout type='vertical' padding='16,16,16,16' spacing='8'> "
"<layout type='horizontal' padding='0,0,0,0' spacing='10' center='true'> "
"<widget name='ThemeButton' "
"type='Button' "
"/> "
"<widget name='CurTheme' "
"height='Globals.Line.Height' "
"/> "
"</layout> "
"<layout type='horizontal' padding='0,0,0,0' spacing='10' center='true'> "
"<widget name='RendererPopupDesc' "
"type='OptionsLabel' "
"/> "
"<widget name='RendererPopup' "
"type='PopUp' "
"/> "
"</layout> "
"<layout type='horizontal' padding='0,0,0,0' spacing='10' center='true'> "
"<widget name='AutosavePeriodPopupDesc' "
"type='OptionsLabel' "
"/> "
"<widget name='AutosavePeriodPopup' "
"type='PopUp' "
"/> "
"</layout> "
"<widget name='KeysButton' "
"type='Button' "
"/> "
"</layout> "
"</dialog> "
"<dialog name='KeysDialog' overlays='Dialog.GlobalOptions' shading='dim'> "
"<layout type='vertical' padding='8,8,8,8' center='true'> "
"<widget name='Action' "
"height='Globals.Line.Height' "
"/> "
"<widget name='List'/> "
"<widget name='Mapping' "
"height='Globals.Line.Height' "
"/> "
"<space size='Globals.Line.Height'/> "
"<layout type='horizontal'> "
"<widget name='Map' "
"type='Button' "
"/> "
"<space/> "
"<widget name='Cancel' "
"type='Button' "
"/> "
"<widget name='Ok' "
"type='Button' "
"/> "
"</layout> "
"</layout> "
"</dialog> "
"<dialog name='GameOptions' overlays='Dialog.Launcher.GameList' shading='dim'> "
"<layout type='vertical' padding='0,0,0,0' spacing='16'> "
"<widget name='TabWidget'/> "
"<layout type='horizontal' padding='16,16,16,4'> "
"<space/> "
"<widget name='Cancel' "
"type='Button' "
"/> "
"<widget name='Ok' "
"type='Button' "
"/> "
"</layout> "
"</layout> "
"</dialog> "
"<dialog name='GameOptions_Graphics' overlays='Dialog.GlobalOptions.TabWidget'> "
"<layout type='vertical' padding='16,16,16,16' spacing='8'> "
"<widget name='EnableTabCheckbox' "
"type='Checkbox' "
"/> "
"<import layout='Dialog.GlobalOptions_Graphics' /> "
"</layout> "
"</dialog> "
"<dialog name='GameOptions_Audio' overlays='Dialog.GlobalOptions.TabWidget'> "
"<layout type='vertical' padding='16,16,16,16' spacing='8'> "
"<widget name='EnableTabCheckbox' "
"type='Checkbox' "
"/> "
"<import layout='Dialog.GlobalOptions_Audio' /> "
"</layout> "
"</dialog> "
"<dialog name='GameOptions_MIDI' overlays='Dialog.GlobalOptions.TabWidget'> "
"<layout type='vertical' padding='16,16,16,16' spacing='8'> "
"<widget name='EnableTabCheckbox' "
"type='Checkbox' "
"/> "
"<import layout='Dialog.GlobalOptions_MIDI' /> "
"</layout> "
"</dialog> "
"<dialog name='GameOptions_Volume' overlays='Dialog.GlobalOptions.TabWidget'> "
"<layout type='vertical' padding='16,16,16,16' spacing='8'> "
"<widget name='EnableTabCheckbox' "
"type='Checkbox' "
"/> "
"<import layout='Dialog.GlobalOptions_Volume' /> "
"</layout> "
"</dialog> "
"<dialog name='GameOptions_Game' overlays='Dialog.GameOptions.TabWidget' shading='dim'> "
"<layout type='vertical' padding='16,16,16,16'> "
"<layout type='horizontal' padding='0,0,0,0' spacing='10' center='true'> "
"<widget name='Id' "
"type='OptionsLabel' "
"/> "
"<widget name='Domain' "
"type='PopUp' "
"/> "
"</layout> "
"<layout type='horizontal' padding='0,0,0,0' spacing='10' center='true'> "
"<widget name='Name' "
"type='OptionsLabel' "
"/> "
"<widget name='Desc' "
"type='PopUp' "
"/> "
"</layout> "
"<layout type='horizontal' padding='0,0,0,0' spacing='10' center='true'> "
"<widget name='LangPopupDesc' "
"type='OptionsLabel' "
"/> "
"<widget name='LangPopup' "
"type='PopUp' "
"/> "
"</layout> "
"<layout type='horizontal' padding='0,0,0,0' spacing='10' center='true'> "
"<widget name='PlatformPopupDesc' "
"type='OptionsLabel' "
"/> "
"<widget name='PlatformPopup' "
"type='PopUp' "
"/> "
"</layout> "
"</layout> "
"</dialog> "
"<dialog name='GameOptions_Paths' overlays='Dialog.GameOptions.TabWidget' shading='dim'> "
"<layout type='vertical' padding='16,16,16,16'> "
"<layout type='horizontal' padding='0,0,0,0' spacing='10' center='true'> "
"<widget name='Savepath' "
"type='Button' "
"/> "
"<widget name='SavepathText' "
"height='Globals.Line.Height' "
"/> "
"</layout> "
"<layout type='horizontal' padding='0,0,0,0' spacing='10' center='true'> "
"<widget name='Extrapath' "
"type='Button' "
"/> "
"<widget name='ExtrapathText' "
"height='Globals.Line.Height' "
"/> "
"</layout> "
"<layout type='horizontal' padding='0,0,0,0' spacing='10' center='true'> "
"<widget name='Gamepath' "
"type='Button' "
"/> "
"<widget name='GamepathText' "
"height='Globals.Line.Height' "
"/> "
"</layout> "
"</layout> "
"</dialog> "
"<dialog name='GlobalMenu' overlays='screen_center'> "
"<layout type='vertical' padding='16,16,16,16' center='true'> "
"<widget name='Title' "
"width='210' "
"height='Globals.Line.Height' "
"/> "
"<widget name='Version' "
"width='210' "
"height='Globals.Line.Height' "
"/> "
"<widget name='Resume' "
"width='150' "
"height='Globals.Button.Height' "
"/> "
"<space size='10'/> "
"<widget name='Load' "
"width='150' "
"height='Globals.Button.Height' "
"/> "
"<widget name='Save' "
"width='150' "
"height='Globals.Button.Height' "
"/> "
"<space size='10'/> "
"<widget name='Options' "
"width='150' "
"height='Globals.Button.Height' "
"/> "
"<widget name='About' "
"width='150' "
"height='Globals.Button.Height' "
"/> "
"<space size='10'/> "
"<widget name='RTL' "
"width='150' "
"height='Globals.Button.Height' "
"/> "
"<widget name='Quit' "
"width='150' "
"height='Globals.Button.Height' "
"/> "
"</layout> "
"</dialog> "
"<dialog name='ScummMain' overlays='screen_center'> "
"<layout type='vertical' padding='8,8,8,8'> "
"<widget name='Resume' "
"type='Button' "
"/> "
"<space size='15'/> "
"<widget name='Load' "
"type='Button' "
"/> "
"<widget name='Save' "
"type='Button' "
"/> "
"<space size='15'/> "
"<widget name='Options' "
"type='Button' "
"/> "
"<widget name='Help' "
"type='Button' "
"/> "
"<widget name='About' "
"type='Button' "
"/> "
"<space size='15'/> "
"<widget name='Quit' "
"type='Button' "
"/> "
"</layout> "
"</dialog> "
"<dialog name='ScummConfig' overlays='screen_center'> "
"<layout type='vertical' padding='8,8,8,8'> "
"<layout type='horizontal' padding='0,0,0,0'> "
"<layout type='vertical' padding='0,0,0,0' center='true'> "
"<layout type='horizontal' padding='0,0,0,0' spacing='8'> "
"<widget name='vcMusicText' "
"type='OptionsLabel' "
"/> "
"<widget name='vcMusicSlider' "
"type='Slider' "
"/> "
"<widget name='vcMusicLabel' "
"type='SmallLabel' "
"/> "
"</layout> "
"<layout type='horizontal' padding='0,0,0,0' spacing='8'> "
"<widget name='vcSfxText' "
"type='OptionsLabel' "
"/> "
"<widget name='vcSfxSlider' "
"type='Slider' "
"/> "
"<widget name='vcSfxLabel' "
"type='SmallLabel' "
"/> "
"</layout> "
"<layout type='horizontal' padding='0,0,0,0' spacing='8'> "
"<widget name='vcSpeechText' "
"type='OptionsLabel' "
"/> "
"<widget name='vcSpeechSlider' "
"type='Slider' "
"/> "
"<widget name='vcSpeechLabel' "
"type='SmallLabel' "
"/> "
"</layout> "
"</layout> "
"<layout type='vertical' padding='24,24,24,24' center='true'> "
"<widget name='vcMuteCheckbox' "
"type='Checkbox' "
"width='80'  "
"/> "
"</layout> "
"</layout> "
"<space size='8' /> "
"<layout type='horizontal' padding='0,0,0,0' spacing='10'> "
"<widget name='subToggleDesc' "
"type='OptionsLabel' "
"/> "
"<widget name='subToggleButton' "
"width='158' "
"height='Globals.Slider.Height' "
"/> "
"</layout> "
"<layout type='horizontal' padding='0,0,0,0' spacing='10'> "
"<widget name='subSubtitleSpeedDesc' "
"type='OptionsLabel' "
"/> "
"<widget name='subSubtitleSpeedSlider' "
"type='Slider' "
"/> "
"<widget name='subSubtitleSpeedLabel' "
"type='SmallLabel' "
"/> "
"</layout> "
"<space size='60'/> "
"<layout type='horizontal' padding='0,0,0,0' spacing='10'> "
"<widget name='Keys' "
"type='Button' "
"/> "
"<space size='Globals.Button.Width' /> "
"<widget name='Cancel' "
"type='Button' "
"/> "
"<widget name='Ok' "
"type='Button' "
"/> "
"</layout> "
"</layout> "
"</dialog> "
"<dialog name='ScummSaveLoad' overlays='screen' inset='8' shading='dim'> "
"<layout type='vertical' padding='8,8,8,32' center='true'> "
"<widget name='Title' "
"height='Globals.Line.Height' "
"/> "
"<layout type='horizontal' padding='0,0,0,16' spacing='16'> "
"<widget name='List' /> "
"<widget name='Thumbnail' "
"width='180' "
"height='200' "
"/> "
"</layout> "
"<layout type='horizontal' padding='0,0,0,0'> "
"<space/> "
"<widget name='Delete' "
"type='Button' "
"/> "
"<space size='32'/> "
"<widget name='Cancel' "
"type='Button' "
"/> "
"<widget name='Choose' "
"type='Button' "
"/> "
"</layout> "
"</layout> "
"</dialog> "
"<dialog name='ScummHelp' overlays='screen_center'> "
"<layout type='vertical' padding='8,8,8,8' center='true'> "
"<widget name='Title' "
"width='320' "
"height='Globals.Line.Height' "
"/> "
"<widget name='HelpText' "
"height='220' "
"/> "
"<layout type='horizontal' padding='0,0,16,0'> "
"<widget name='Prev' "
"type='Button' "
"/> "
"<widget name='Next' "
"type='Button' "
"/> "
"<space size='32'/> "
"<widget name='Close' "
"type='Button' "
"/> "
"</layout> "
"</layout> "
"</dialog> "
"<dialog name='MassAdd' overlays='screen_center' shading='dim'> "
"<layout type='vertical' padding='8,8,32,8' center='true'> "
"<widget name='DirProgressText' "
"width='250' "
"height='Globals.Line.Height' "
"/> "
"<widget name='GameProgressText' "
"width='250' "
"height='Globals.Line.Height' "
"/> "
"<widget name='GameList' "
"width='480' "
"height='250' "
"/> "
"<layout type='horizontal' padding='8,8,8,8'> "
"<widget name='Ok' "
"type='Button' "
"/> "
"<widget name='Cancel' "
"type='Button' "
"/> "
"</layout> "
"</layout> "
"</dialog> "
"</layout_info> "
"<layout_info resolution='320xY,256x240,Xx272'> "
"<globals> "
"<def var='Line.Height' value='12' /> "
"<def var='Font.Height' value='10' /> "
"<def var='About.OuterBorder' value='10'/> "
"<def var='Layout.Spacing' value='8'/> "
"<def var='ShowLauncherLogo' value='0'/> "
"<def var='ShowGlobalMenuLogo' value='0'/> "
"<def var='ScummSaveLoad.ExtInfo.Visible' value='0'/> "
"<widget name='Button' "
"size='72,16' "
"/> "
"<widget name='Slider' "
"size='85,12' "
"/> "
"<widget name='OptionsLabel' "
"size='110,Globals.Line.Height' "
"textalign='right' "
"/> "
"<widget name='SmallLabel' "
"size='18,Globals.Line.Height' "
"/> "
"<widget name='PopUp' "
"size='-1,15' "
"/> "
"<widget name='Checkbox' "
"size='-1,Globals.Line.Height' "
"/> "
"<widget name='ListWidget' "
"padding='5,0,0,0' "
"/> "
"<widget name='PopUpWidget' "
"padding='7,5,0,0' "
"/> "
"<widget name='EditTextWidget' "
"padding='5,5,0,0' "
"/> "
"<widget name='Console' "
"padding='7,5,5,5' "
"/> "
"<widget name='Scrollbar' "
"size='9,0' "
"/> "
"<widget name='TabWidget.Tab' "
"size='45,16' "
"padding='0,0,2,0' "
"/> "
"<widget name='TabWidget.NavButton' "
"size='32,18' "
"padding='0,3,4,0' "
"/> "
"</globals> "
"<dialog name='Launcher' overlays='screen'> "
"<layout type='vertical' center='true' padding='8,8,4,4'> "
"<widget name='Version' "
"height='Globals.Line.Height' "
"/> "
"<widget name='GameList'/> "
"<layout type='horizontal' padding='0,0,0,0' spacing='10'> "
"<widget name='LoadGameButton' "
"height='12' "
"/> "
"<widget name='AddGameButton' "
"height='12' "
"/> "
"<widget name='EditGameButton' "
"height='12' "
"/> "
"<widget name='RemoveGameButton' "
"height='12' "
"/> "
"</layout> "
"<layout type='horizontal' padding='0,0,0,0' spacing='10'> "
"<widget name='QuitButton' "
"height='12' "
"/> "
"<widget name='AboutButton' "
"height='12' "
"/> "
"<widget name='OptionsButton' "
"height='12' "
"/> "
"<widget name='StartButton' "
"height='12' "
"/> "
"</layout> "
"</layout> "
"</dialog> "
"<dialog name='Browser' overlays='screen' inset='8' shading='dim'> "
"<layout type='vertical' padding='8,8,0,4'> "
"<widget name='Headline' "
"height='Globals.Line.Height' "
"/> "
"<widget name='Path' "
"height='Globals.Line.Height' "
"/> "
"<widget name='List'/> "
"<layout type='horizontal' padding='0,0,8,0'> "
"<widget name='Up' "
"type='Button' "
"/> "
"<space/> "
"<widget name='Cancel' "
"type='Button' "
"/> "
"<widget name='Choose' "
"type='Button' "
"/> "
"</layout> "
"</layout> "
"</dialog> "
"<dialog name='GlobalOptions' overlays='screen' inset='16' shading='dim'> "
"<layout type='vertical' padding='0,0,0,0'> "
"<widget name='TabWidget'/> "
"<layout type='horizontal' padding='8,8,8,8'> "
"<space/> "
"<widget name='Cancel' "
"type='Button' "
"/> "
"<widget name='Ok' "
"type='Button' "
"/> "
"</layout> "
"</layout> "
"</dialog> "
"<dialog name='GlobalOptions_Graphics' overlays='Dialog.GlobalOptions.TabWidget'> "
"<layout type='vertical' padding='16,16,16,16' spacing='8'> "
"<layout type='horizontal' padding='0,0,0,0' spacing='6' center='true'> "
"<widget name='grModePopupDesc' "
"type='OptionsLabel' "
"/> "
"<widget name='grModePopup' "
"type='PopUp' "
"/> "
"</layout> "
"<layout type='horizontal' padding='0,0,0,0' spacing='6' center='true'> "
"<widget name='grRenderPopupDesc' "
"type='OptionsLabel' "
"/> "
"<widget name='grRenderPopup' "
"type='PopUp' "
"/> "
"</layout> "
"<widget name='grAspectCheckbox' "
"type='Checkbox' "
"/> "
"<widget name='grFullscreenCheckbox' "
"type='Checkbox' "
"/> "
"</layout> "
"</dialog> "
"<dialog name='GlobalOptions_Audio' overlays='Dialog.GlobalOptions.TabWidget'> "
"<layout type='vertical' padding='16,16,16,16' spacing='8'> "
"<layout type='horizontal' padding='0,0,0,0' spacing='6' center='true'> "
"<widget name='auMidiPopupDesc' "
"type='OptionsLabel' "
"/> "
"<widget name='auMidiPopup' "
"type='PopUp' "
"/> "
"</layout> "
"<layout type='horizontal' padding='0,0,0,0' spacing='6' center='true'> "
"<widget name='auOPLPopupDesc' "
"type='OptionsLabel' "
"/> "
"<widget name='auOPLPopup' "
"type='PopUp' "
"/> "
"</layout> "
"<layout type='horizontal' padding='0,0,0,0' spacing='6' center='true'> "
"<widget name='auSampleRatePopupDesc' "
"type='OptionsLabel' "
"/> "
"<widget name='auSampleRatePopup' "
"type='PopUp' "
"/> "
"</layout> "
"<layout type='horizontal' padding='0,0,0,0' spacing='6' center='true'> "
"<widget name='subToggleDesc' "
"type='OptionsLabel' "
"/> "
"<widget name='subToggleButton' "
"width='128' "
"height='Globals.Slider.Height' "
"/> "
"</layout> "
"<layout type='horizontal' padding='0,0,0,0' spacing='6' center='true'> "
"<widget name='subSubtitleSpeedDesc' "
"type='OptionsLabel' "
"/> "
"<widget name='subSubtitleSpeedSlider' "
"type='Slider' "
"/> "
"<widget name='subSubtitleSpeedLabel' "
"type='SmallLabel' "
"/> "
"</layout> "
"</layout> "
"</dialog> "
"<dialog name='GlobalOptions_Volume' overlays='Dialog.GlobalOptions.TabWidget'> "
"<layout type='vertical' padding='16,16,16,16' spacing='8'> "
"<layout type='horizontal' padding='0,0,0,0' spacing='6' center='true'> "
"<widget name='vcMusicText' "
"type='OptionsLabel' "
"/> "
"<widget name='vcMusicSlider' "
"type='Slider' "
"/> "
"<widget name='vcMusicLabel' "
"type='SmallLabel' "
"/> "
"</layout> "
"<layout type='horizontal' padding='0,0,0,0' spacing='6' center='true'> "
"<widget name='vcSfxText' "
"type='OptionsLabel' "
"/> "
"<widget name='vcSfxSlider' "
"type='Slider' "
"/> "
"<widget name='vcSfxLabel' "
"type='SmallLabel' "
"/> "
"</layout> "
"<layout type='horizontal' padding='0,0,0,0' spacing='6' center='true'> "
"<widget name='vcSpeechText' "
"type='OptionsLabel' "
"/> "
"<widget name='vcSpeechSlider' "
"type='Slider' "
"/> "
"<widget name='vcSpeechLabel' "
"type='SmallLabel' "
"/> "
"</layout> "
"<layout type='horizontal' padding='0,0,0,0' spacing='6' center='true'> "
"<space size='110' /> "
"<widget name='vcMuteCheckbox' "
"type='Checkbox' "
"/> "
"</layout> "
"</layout> "
"</dialog> "
"<dialog name='GlobalOptions_MIDI' overlays='Dialog.GlobalOptions.TabWidget'> "
"<layout type='vertical' padding='16,16,16,16' spacing='8'> "
"<layout type='horizontal' padding='0,0,0,0' spacing='16' center='true'> "
"<widget name='mcFontButton' "
"type='Button' "
"/> "
"<widget name='mcFontPath' "
"height='Globals.Line.Height' "
"/> "
"<widget name='mcFontClearButton' "
"height='Globals.Line.Height' "
"width='Globals.Line.Height' "
"/> "
"</layout> "
"<widget name='mcMixedCheckbox' "
"type='Checkbox' "
"/> "
"<widget name='mcMt32Checkbox' "
"type='Checkbox' "
"/> "
"<widget name='mcGSCheckbox' "
"type='Checkbox' "
"/> "
"<layout type='horizontal' padding='0,0,0,0' spacing='6' center='true'> "
"<widget name='mcMidiGainText' "
"type='OptionsLabel' "
"/> "
"<widget name='mcMidiGainSlider' "
"type='Slider' "
"/> "
"<widget name='mcMidiGainLabel' "
"width='32' "
"height='Globals.Line.Height' "
"/> "
"</layout> "
"</layout> "
"</dialog> "
"<dialog name='GlobalOptions_Paths' overlays='Dialog.GlobalOptions.TabWidget'> "
"<layout type='vertical' padding='16,16,16,16' spacing='8'> "
"<layout type='horizontal' padding='0,0,0,0' spacing='16'> "
"<widget name='SaveButton' "
"type='Button' "
"/> "
"<widget name='SavePath' "
"height='Globals.Line.Height' "
"/> "
"</layout> "
"<layout type='horizontal' padding='0,0,0,0' spacing='16'> "
"<widget name='ThemeButton' "
"type='Button' "
"/> "
"<widget name='ThemePath' "
"height='Globals.Line.Height' "
"/> "
"</layout> "
"<layout type='horizontal' padding='0,0,0,0' spacing='16'> "
"<widget name='ExtraButton' "
"type='Button' "
"/> "
"<widget name='ExtraPath' "
"height='Globals.Line.Height' "
"/> "
"</layout> "
"<layout type='horizontal' padding='0,0,0,0' spacing='16'> "
"<widget name='PluginsButton' "
"type='Button' "
"/> "
"<widget name='PluginsPath' "
"height='Globals.Line.Height' "
"/> "
"</layout> "
"</layout> "
"</dialog> "
"<dialog name='GlobalOptions_Misc' overlays='Dialog.GlobalOptions.TabWidget'> "
"<layout type='vertical' padding='16,16,16,16' spacing='8'> "
"<layout type='horizontal' padding='0,0,0,0' spacing='16'> "
"<widget name='ThemeButton' "
"type='Button' "
"/> "
"<widget name='CurTheme' "
"height='Globals.Line.Height' "
"/> "
"</layout> "
"<layout type='horizontal' padding='0,0,0,0' spacing='6' center='true'> "
"<widget name='RendererPopupDesc' "
"width='80' "
"height='Globals.Line.Height' "
"textalign='right' "
"/> "
"<widget name='RendererPopup' "
"type='PopUp' "
"/> "
"</layout> "
"<layout type='horizontal' padding='0,0,0,0' spacing='6' center='true'> "
"<widget name='AutosavePeriodPopupDesc' "
"width='80' "
"height='Globals.Line.Height' "
"textalign='right' "
"/> "
"<widget name='AutosavePeriodPopup' "
"type='PopUp' "
"/> "
"</layout> "
"<widget name='KeysButton' "
"type='Button' "
"/> "
"</layout> "
"</dialog> "
"<dialog name='KeysDialog' overlays='Dialog.GlobalOptions' shading='dim'> "
"<layout type='vertical' padding='8,8,8,8' center='true'> "
"<widget name='Action' "
"height='Globals.Line.Height' "
"/> "
"<widget name='List'/> "
"<widget name='Mapping' "
"height='Globals.Line.Height' "
"/> "
"<space size='Globals.Line.Height'/> "
"<layout type='horizontal'> "
"<widget name='Map' "
"type='Button' "
"/> "
"<space/> "
"<widget name='Cancel' "
"type='Button' "
"/> "
"<widget name='Ok' "
"type='Button' "
"/> "
"</layout> "
"</layout> "
"</dialog> "
"<dialog name='GameOptions' overlays='screen' inset='16' shading='dim'> "
"<layout type='vertical' padding='0,0,0,0' spacing='16'> "
"<widget name='TabWidget'/> "
"<layout type='horizontal' padding='8,8,8,8'> "
"<space/> "
"<widget name='Cancel' "
"type='Button' "
"/> "
"<widget name='Ok' "
"type='Button' "
"/> "
"</layout> "
"</layout> "
"</dialog> "
"<dialog name='GameOptions_Graphics' overlays='Dialog.GlobalOptions.TabWidget'> "
"<layout type='vertical' padding='16,16,16,16' spacing='8'> "
"<widget name='EnableTabCheckbox' "
"type='Checkbox' "
"/> "
"<import layout='Dialog.GlobalOptions_Graphics' /> "
"</layout> "
"</dialog> "
"<dialog name='GameOptions_Audio' overlays='Dialog.GlobalOptions.TabWidget'> "
"<layout type='vertical' padding='16,16,16,16' spacing='8'> "
"<widget name='EnableTabCheckbox' "
"type='Checkbox' "
"/> "
"<import layout='Dialog.GlobalOptions_Audio' /> "
"</layout> "
"</dialog> "
"<dialog name='GameOptions_MIDI' overlays='Dialog.GlobalOptions.TabWidget'> "
"<layout type='vertical' padding='16,16,16,16' spacing='8'> "
"<widget name='EnableTabCheckbox' "
"type='Checkbox' "
"/> "
"<import layout='Dialog.GlobalOptions_MIDI' /> "
"</layout> "
"</dialog> "
"<dialog name='GameOptions_Volume' overlays='Dialog.GlobalOptions.TabWidget'> "
"<layout type='vertical' padding='16,16,16,16' spacing='8'> "
"<widget name='EnableTabCheckbox' "
"type='Checkbox' "
"/> "
"<import layout='Dialog.GlobalOptions_Volume' /> "
"</layout> "
"</dialog> "
"<dialog name='GameOptions_Game' overlays='Dialog.GameOptions.TabWidget' shading='dim'> "
"<layout type='vertical' padding='16,16,16,16'> "
"<layout type='horizontal' padding='0,0,0,0' spacing='6' center='true'> "
"<widget name='Id' "
"width='35' "
"height='Globals.Line.Height' "
"textalign='right' "
"/> "
"<widget name='Domain' "
"type='PopUp' "
"/> "
"</layout> "
"<layout type='horizontal' padding='0,0,0,0' spacing='6' center='true'> "
"<widget name='Name' "
"width='35' "
"height='Globals.Line.Height' "
"textalign='right' "
"/> "
"<widget name='Desc' "
"type='PopUp' "
"/> "
"</layout> "
"<space size='8'/> "
"<layout type='horizontal' padding='0,0,0,0' spacing='6' center='true'> "
"<widget name='LangPopupDesc' "
"width='60' "
"height='Globals.Line.Height' "
"textalign='right' "
"/> "
"<widget name='LangPopup' "
"type='PopUp' "
"/> "
"</layout> "
"<layout type='horizontal' padding='0,0,0,0' spacing='6' center='true'> "
"<widget name='PlatformPopupDesc' "
"width='60' "
"height='Globals.Line.Height' "
"textalign='right' "
"/> "
"<widget name='PlatformPopup' "
"type='PopUp' "
"/> "
"</layout> "
"</layout> "
"</dialog> "
"<dialog name='GameOptions_Paths' overlays='Dialog.GameOptions.TabWidget' shading='dim'> "
"<layout type='vertical' padding='16,16,16,16'> "
"<layout type='horizontal' padding='0,0,0,0' spacing='16' center='true'> "
"<widget name='Savepath' "
"type='Button' "
"/> "
"<widget name='SavepathText' "
"height='Globals.Line.Height' "
"/> "
"</layout> "
"<layout type='horizontal' padding='0,0,0,0' spacing='16' center='true'> "
"<widget name='Extrapath' "
"type='Button' "
"/> "
"<widget name='ExtrapathText' "
"height='Globals.Line.Height' "
"/> "
"</layout> "
"<layout type='horizontal' padding='0,0,0,0' spacing='16' center='true'> "
"<widget name='Gamepath' "
"type='Button' "
"/> "
"<widget name='GamepathText' "
"height='Globals.Line.Height' "
"/> "
"</layout> "
"</layout> "
"</dialog> "
"<dialog name='GlobalMenu' overlays='screen_center'> "
"<layout type='vertical' padding='8,8,4,6' center='true'> "
"<widget name='Title' "
"width='160' "
"height='4' "
"/> "
"<widget name='Version' "
"width='160' "
"height='4' "
"/> "
"<space size='1'/> "
"<widget name='Load' "
"width='120' "
"height='12' "
"/> "
"<widget name='Save' "
"width='120' "
"height='12' "
"/> "
"<space size='1'/> "
"<widget name='Options' "
"width='120' "
"height='12' "
"/> "
"<widget name='About' "
"width='120' "
"height='12' "
"/> "
"<space size='1'/> "
"<widget name='Resume' "
"width='120' "
"height='12' "
"/> "
"<widget name='RTL' "
"width='120' "
"height='12' "
"/> "
"<widget name='Quit' "
"width='120' "
"height='12' "
"/> "
"</layout> "
"</dialog> "
"<dialog name='ScummMain' overlays='screen_center'> "
"<layout type='vertical' padding='8,8,8,8'> "
"<widget name='Resume' "
"width='Globals.Button.Width' "
"height='14' "
"/> "
"<space size='2'/> "
"<widget name='Load' "
"width='Globals.Button.Width' "
"height='14' "
"/> "
"<widget name='Save' "
"width='Globals.Button.Width' "
"height='14' "
"/> "
"<space size='2'/> "
"<widget name='Options' "
"width='Globals.Button.Width' "
"height='14' "
"/> "
"<widget name='Help' "
"width='Globals.Button.Width' "
"height='14' "
"/> "
"<widget name='About' "
"width='Globals.Button.Width' "
"height='14' "
"/> "
"<space size='2'/> "
"<widget name='Quit' "
"width='Globals.Button.Width' "
"height='14' "
"/> "
"</layout> "
"</dialog> "
"<dialog name='ScummConfig' overlays='screen_center'> "
"<layout type='vertical' padding='8,8,8,8'> "
"<layout type='horizontal' padding='0,0,0,0' spacing='6' center='true'> "
"<widget name='vcMusicText' "
"type='OptionsLabel' "
"/> "
"<widget name='vcMusicSlider' "
"type='Slider' "
"/> "
"<widget name='vcMusicLabel' "
"type='SmallLabel' "
"/> "
"</layout> "
"<layout type='horizontal' padding='0,0,0,0' spacing='6' center='true'> "
"<widget name='vcSfxText' "
"type='OptionsLabel' "
"/> "
"<widget name='vcSfxSlider' "
"type='Slider' "
"/> "
"<widget name='vcSfxLabel' "
"type='SmallLabel' "
"/> "
"</layout> "
"<layout type='horizontal' padding='0,0,0,0' spacing='6' center='true'> "
"<widget name='vcSpeechText' "
"type='OptionsLabel' "
"/> "
"<widget name='vcSpeechSlider' "
"type='Slider' "
"/> "
"<widget name='vcSpeechLabel' "
"type='SmallLabel' "
"/> "
"</layout> "
"<layout type='horizontal' padding='0,0,0,0' spacing='6' center='true'> "
"<space size='110' /> "
"<widget name='vcMuteCheckbox' "
"type='Checkbox' "
"width='80' "
"/> "
"</layout> "
"<space size='4' /> "
"<layout type='horizontal' padding='0,0,0,0' spacing='6' center='true'> "
"<widget name='subToggleDesc' "
"type='OptionsLabel' "
"/> "
"<widget name='subToggleButton' "
"width='128' "
"height='Globals.Slider.Height' "
"/> "
"</layout> "
"<layout type='horizontal' padding='0,0,0,0' spacing='6' center='true'> "
"<widget name='subSubtitleSpeedDesc' "
"type='OptionsLabel' "
"/> "
"<widget name='subSubtitleSpeedSlider' "
"type='Slider' "
"/> "
"<widget name='subSubtitleSpeedLabel' "
"type='SmallLabel' "
"/> "
"</layout> "
"<space size='20'/> "
"<layout type='horizontal' padding='0,0,0,0' spacing='4'> "
"<widget name='Keys' "
"type='Button' "
"/> "
"<space size='Globals.Button.Width' /> "
"<widget name='Cancel' "
"type='Button' "
"/> "
"<widget name='Ok' "
"type='Button' "
"/> "
"</layout> "
"</layout> "
"</dialog> "
"<dialog name='ScummSaveLoad' overlays='screen' inset='8' shading='dim'> "
"<layout type='vertical' padding='8,8,8,8' center='true'> "
"<widget name='Title' height='Globals.Line.Height'/> "
"<widget name='List' /> "
"<layout type='horizontal' padding='0,0,16,0'> "
"<space/> "
"<widget name='Delete' "
"type='Button' "
"/> "
"<space size='16'/> "
"<widget name='Cancel' "
"type='Button' "
"/> "
"<widget name='Choose' "
"type='Button' "
"/> "
"</layout> "
"</layout> "
"</dialog> "
"<dialog name='ScummHelp' overlays='screen'> "
"<layout type='vertical' padding='8,8,0,0'> "
"<widget name='Title' "
"width='180' "
"height='Globals.Line.Height' "
"/> "
"<widget name='HelpText' "
"height='140' "
"/> "
"<layout type='horizontal' padding='0,0,0,0'> "
"<widget name='Prev' "
"type='Button' "
"/> "
"<widget name='Next' "
"type='Button' "
"/> "
"<space size='32'/> "
"<widget name='Close' "
"type='Button' "
"/> "
"</layout> "
"</layout> "
"</dialog> "
"<dialog name='MassAdd' overlays='screen_center' shading='dim'> "
"<layout type='vertical' padding='4,4,16,4' center='true'> "
"<widget name='DirProgressText' "
"width='240' "
"height='Globals.Line.Height' "
"/> "
"<widget name='GameProgressText' "
"width='240' "
"height='Globals.Line.Height' "
"/> "
"<widget name='GameList' "
"width='280' "
"height='100' "
"/> "
"<layout type='horizontal' padding='4,4,4,4'> "
"<widget name='Ok' "
"type='Button' "
"/> "
"<widget name='Cancel' "
"type='Button' "
"/> "
"</layout> "
"</layout> "
"</dialog> "
"</layout_info> "
